## config/boards/shields/charybdis/Kconfig.shield
```kconfig
config SHIELD_CHARYBDIS_LEFT
	def_bool $(shields_list_contains,charybdis_left)

config SHIELD_CHARYBDIS_RIGHT_STANDALONE
	def_bool $(shields_list_contains,charybdis_right_standalone)

config SHIELD_CHARYBDIS_RIGHT_DONGLE
	def_bool $(shields_list_contains,charybdis_right_dongle)

config SHIELD_PROSPECTOR_DONGLE
	def_bool $(shields_list_contains,prospector_dongle)

config SHIELD_BWSHOCKLEY_PROSPECTOR
	def_bool $(shields_list_contains,bwshockley_prospector)

config SHIELD_NICE_DONGLE
	def_bool $(shields_list_contains,nice_dongle)
```
